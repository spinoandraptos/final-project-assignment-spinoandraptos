## base_external/Config.in
```kconfig
source "$BR2_EXTERNAL_assignment_base_PATH/package/python_wave/Config.in"
source "$BR2_EXTERNAL_assignment_base_PATH/package/python_pyaudio/Config.in"
source "$BR2_EXTERNAL_assignment_base_PATH/package/python_pvrecorder/Config.in"
source "$BR2_EXTERNAL_assignment_base_PATH/package/python_rvadfast/Config.in"
source "$BR2_EXTERNAL_assignment_base_PATH/package/python_scipy/Config.in"
source "$BR2_EXTERNAL_assignment_base_PATH/package/python_transformers/Config.in"
source "$BR2_EXTERNAL_assignment_base_PATH/package/python_rplcd/Config.in"
source "$BR2_EXTERNAL_assignment_base_PATH/package/python_rpigpio/Config.in"
source "$BR2_EXTERNAL_assignment_base_PATH/package/python_librosa/Config.in"
source "$BR2_EXTERNAL_assignment_base_PATH/package/python_sounddevice/Config.in"
source "$BR2_EXTERNAL_assignment_base_PATH/package/python_torch/Config.in"
source "$BR2_EXTERNAL_assignment_base_PATH/package/python_whisper/Config.in"
source "$BR2_EXTERNAL_assignment_base_PATH/package/python_vosk/Config.in"
source "$BR2_EXTERNAL_assignment_base_PATH/package/python_cmudict/Config.in"
source "$BR2_EXTERNAL_assignment_base_PATH/package/python_speechrecognition/Config.in"
source "$BR2_EXTERNAL_assignment_base_PATH/package/python_pocketsphinx/Config.in"
source "$BR2_EXTERNAL_assignment_base_PATH/package/python_scikit_build/Config.in"
source "$BR2_EXTERNAL_assignment_base_PATH/package/python_scikit_build_core/Config.in"
source "$BR2_EXTERNAL_assignment_base_PATH/package/python_nltk/Config.in"
source "$BR2_EXTERNAL_assignment_base_PATH/package/hw_gpio/Config.in"
source "$BR2_EXTERNAL_assignment_base_PATH/package/hw_lcd/Config.in"
source "$BR2_EXTERNAL_assignment_base_PATH/package/hw_mic/Config.in"
source "$BR2_EXTERNAL_assignment_base_PATH/package/hw_integration/Config.in"
source "$BR2_EXTERNAL_assignment_base_PATH/package/sw_asr/Config.in"
source "$BR2_EXTERNAL_assignment_base_PATH/package/sw_grading/Config.in"
```

## base_external/package/hw_gpio/Config.in
```kconfig
config BR2_PACKAGE_HW_GPIO
	bool "hw-gpio"
	help
	  Includes the gpio python test programs in the kernel image.
	  Used to understand buildroot external trees and package builds.
```

## base_external/package/hw_integration/Config.in
```kconfig
config BR2_PACKAGE_HW_INTEGRATION
	bool "hw-integration"
	help
	  Includes the integrated python test programs in the kernel image.
	  Used to understand buildroot external trees and package builds.
```

## base_external/package/hw_lcd/Config.in
```kconfig
config BR2_PACKAGE_HW_LCD
	bool "hw-lcd"
	help
	  Includes the lcd python test programs in the kernel image.
	  Used to understand buildroot external trees and package builds.
```

## base_external/package/hw_mic/Config.in
```kconfig
config BR2_PACKAGE_HW_MIC
	bool "hw-mic"
	help
	  Includes the mic python test programs in the kernel image.
	  Used to understand buildroot external trees and package builds.
```

## base_external/package/python_cmudict/Config.in
```kconfig
config BR2_PACKAGE_PYTHON_CMUDICT
	bool "python-cmudict"
	help
	  This package includes cmudict python package.
	  Helps to understand buildroot external trees and package builds.
```

## base_external/package/python_librosa/Config.in
```kconfig
config BR2_PACKAGE_PYTHON_LIBROSA
	bool "python-librosa"
	help
	  This package includes librosa python package.
	  Helps to understand buildroot external trees and package builds.
```

## base_external/package/python_nltk/Config.in
```kconfig
config BR2_PACKAGE_PYTHON_NLTK
	bool "python-nltk"
	help
	  This package includes nltk python package.
	  Helps to understand buildroot external trees and package builds.
```

## base_external/package/python_pocketsphinx/Config.in
```kconfig
config BR2_PACKAGE_PYTHON_POCKETSPHINX
	bool "python-pocketsphinx"
	help
	  This package includes pocketsphinx python package.
	  Helps to understand buildroot external trees and package builds.
```

## base_external/package/python_pvrecorder/Config.in
```kconfig
config BR2_PACKAGE_PYTHON_PVRECORDER
	bool "python-pvrecorder"
	help
	  This package includes pvrecorder python package.
	  Helps to understand buildroot external trees and package builds.
```

## base_external/package/python_rplcd/Config.in
```kconfig
config BR2_PACKAGE_PYTHON_RPLCD
	bool "python-rplcd"
	help
	  This package includes rplcd python package.
	  Helps to understand buildroot external trees and package builds.
```

## base_external/package/python_rvadfast/Config.in
```kconfig
config BR2_PACKAGE_PYTHON_RVADFAST
	bool "python-rvadfast"
	help
	  This package includes rvadfast python package.
	  Helps to understand buildroot external trees and package builds.
```

## base_external/package/python_scikit_build/Config.in
```kconfig
config BR2_PACKAGE_PYTHON_SCIKIT_BUILD
	bool "python-scikit-build"
	help
	  This package includes scikit-build python package.
	  Helps to understand buildroot external trees and package builds.
```

## base_external/package/python_scikit_build_core/Config.in
```kconfig
config BR2_PACKAGE_PYTHON_SCIKIT_BUILD_CORE
	bool "python-scikit-build-core"
	help
	  This package includes scikit-build-core python package.
	  Helps to understand buildroot external trees and package builds.
```

## base_external/package/python_scipy/Config.in
```kconfig
config BR2_PACKAGE_PYTHON_SCIPY
	bool "python-scipy"
	help
	  This package includes scipy python package.
	  Helps to understand buildroot external trees and package builds.
```

## base_external/package/python_sounddevice/Config.in
```kconfig
config BR2_PACKAGE_PYTHON_SOUNDDEVICE
	bool "python-sounddevice"
	help
	  This package includes sounddevice python package.
	  Helps to understand buildroot external trees and package builds.
```

## base_external/package/python_speechrecognition/Config.in
```kconfig
config BR2_PACKAGE_PYTHON_SPEECHRECOGNITION
	bool "python-speechrecognition"
	help
	  This package includes speechrecognition python package.
	  Helps to understand buildroot external trees and package builds.
```

## base_external/package/python_torch/Config.in
```kconfig
config BR2_PACKAGE_PYTHON_TORCH
	bool "python-torch"
	select BR2_PACKAGE_PYTHON_PYYAML
	help
	  This package includes torch python package.
	  Helps to understand buildroot external trees and package builds.
```

## base_external/package/python_transformers/Config.in
```kconfig
config BR2_PACKAGE_PYTHON_TRANSFORMERS
	bool "python-transformers"
	help
	  This package includes transformers python package.
	  Helps to understand buildroot external trees and package builds.
```

## base_external/package/python_vosk/Config.in
```kconfig
config BR2_PACKAGE_PYTHON_VOSK
	bool "python-vosk"
	help
	  This package includes vosk python package.
	  Helps to understand buildroot external trees and package builds.
```

## base_external/package/python_wave/Config.in
```kconfig
config BR2_PACKAGE_PYTHON_WAVE
	bool "python-wave"
	help
	  This package includes wave python package.
	  Helps to understand buildroot external trees and package builds.
```

## base_external/package/python_whisper/Config.in
```kconfig
config BR2_PACKAGE_PYTHON_WHISPER
	bool "python-whisper"
	help
	  This package includes whisper python package.
	  Helps to understand buildroot external trees and package builds.
```

## base_external/package/sw_asr/Config.in
```kconfig
config BR2_PACKAGE_SW_ASR
	bool "sw-asr"
	help
	  Includes the asr python test programs in the kernel image.
	  Used to understand buildroot external trees and package builds.
```

## base_external/package/sw_grading/Config.in
```kconfig
config BR2_PACKAGE_SW_GRADING
	bool "sw-grading"
	help
	  Includes the grading python test programs in the kernel image.
	  Used to understand buildroot external trees and package builds.
```
